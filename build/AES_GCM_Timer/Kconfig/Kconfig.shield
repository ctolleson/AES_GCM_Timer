## build/AES_GCM_Timer/Kconfig/Kconfig.shield
```kconfig
osource "C:/Git/AES_GCM_Timer/boards/shields/*/Kconfig.shield"
osource "C:/ncs/v2.9.0/nrf/boards/shields/*/Kconfig.shield"
```

## build/AES_GCM_Timer/Kconfig/Kconfig.shield.defconfig
```kconfig
osource "C:/Git/AES_GCM_Timer/boards/shields/*/Kconfig.defconfig"
osource "C:/ncs/v2.9.0/nrf/boards/shields/*/Kconfig.defconfig"
```

## build/Kconfig/Kconfig.shield
```kconfig
osource "c:/git/aes_gcm_timer/boards/shields/*/Kconfig.shield"
osource "C:/ncs/v2.6.2/nrf/boards/shields/*/Kconfig.shield"
```

## build/Kconfig/Kconfig.shield.defconfig
```kconfig
osource "c:/git/aes_gcm_timer/boards/shields/*/Kconfig.defconfig"
osource "C:/ncs/v2.6.2/nrf/boards/shields/*/Kconfig.defconfig"
```
