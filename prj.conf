## prj.conf
```kconfig
#
# Copyright (c) 2024 Nordic Semiconductor ASA
#
# SPDX-License-Identifier: LicenseRef-Nordic-5-Clause
#
# The Zephyr CMSIS emulation assumes that ticks are ms, currently
CONFIG_SYS_CLOCK_TICKS_PER_SEC=1000

CONFIG_MAIN_STACK_SIZE=4096
CONFIG_HEAP_MEM_POOL_SIZE=4096

# Enable logging
CONFIG_CONSOLE=y
CONFIG_LOG=y

# Enable nordic security backend and PSA APIs
CONFIG_NRF_SECURITY=y
CONFIG_MBEDTLS_PSA_CRYPTO_C=y

CONFIG_PSA_WANT_GENERATE_RANDOM=y
CONFIG_PSA_WANT_KEY_TYPE_AES=y
CONFIG_PSA_WANT_ALG_GCM=y

CONFIG_TIMING_FUNCTIONS=y
```

## src/main.c
```c
/**
 * 
 * https://academy.nordicsemi.com/courses/nrf-connect-sdk-fundamentals/lessons/lesson-3-printing-messages-to-console-and-logging/topic/printk-function/#:~:text=However%2C%20printk()%20is%20a,d%20%2C%20%25i%20and%20its%20subcategories
 * For printing basic messages on a console, we can use the printk() method. 
 * The syntax printk() is similar to the standard printf() in C, you can provide either
 *  a string literal or a format string followed by one or more variables to be printed. 
 * However, printk() is a less advanced function that only supports a subset of the features 
 * that printf() does, making it optimized for embedded development.
 * 
 * Installation instructions help.
 * 
 * 
 */


/*
 * Copyright (c) 2021 Nordic Semiconductor ASA
 *
 * SPDX-License-Identifier: LicenseRef-Nordic-5-Clause
 * 
 * Sources of information to help. 
 * https://docs.nordicsemi.com/bundle/ncs-2.4.0/page/zephyr/kernel/timing_functions/index.html
 * https://www.google.com/search?client=safari&rls=en&q=convert+nanoseconds+to+seconds&ie=UTF-8&oe=UTF-8
 * https://www.argenox.com/library/bluetooth-low-energy/ble-advertising-primer/
 * https://arm-software.github.io/psa-api/crypto/1.1/api/ops/aead.html#c.psa_aead_encrypt
 * 
 * Benchmarks 
 * https://www.wolfssl.com/docs/benchmarks/
 * https://os.mbed.com/teams/mbed-os-examples/code/mbed-os-example-tls-benchmark/file/0af60cd5226d/main.cpp/
 * 
 * 
 * 
 */

 #include <zephyr/kernel.h>
 #include <zephyr/sys/printk.h>
 #include <zephyr/logging/log.h>
 #include <stdio.h>
 #include <stdlib.h>
 #include <psa/crypto.h>
 #include <psa/crypto_extra.h>
 
 
 
 #define CAPTURE_TIMING 
 
 
 #ifdef	CAPTURE_TIMING
 #include <zephyr/timing/timing.h>
 #endif 
 
 #ifdef CONFIG_BUILD_WITH_TFM
 #include <tfm_ns_interface.h>
 #endif
 
 #define APP_SUCCESS             (0)
 #define APP_ERROR               (-1)
 #define APP_SUCCESS_MESSAGE "Example finished successfully!"
 #define APP_ERROR_MESSAGE "Example exited with error!"
 
 #define PRINT_HEX(p_label, p_text, len)				  \
	 ({							  \
		 LOG_INF("---- %s (len: %u): ----", p_label, len); \
		 LOG_HEXDUMP_INF(p_text, len, "Content:");	  \
		 LOG_INF("---- %s end  ----", p_label);		  \
	 })
 
 LOG_MODULE_REGISTER(aes_gcm, LOG_LEVEL_DBG);
 
 /* ====================================================================== */
 /*			Global variables/defines for the AES GCM mode example		  */
 
 #define NRF_CRYPTO_EXAMPLE_AES_MAX_TEXT_SIZE (100)
 #define NRF_CRYPTO_EXAMPLE_AES_BLOCK_SIZE (16)
 #define NRF_CRYPTO_EXAMPLE_AES_IV_SIZE (12)
 #define NRF_CRYPTO_EXAMPLE_AES_ADDITIONAL_SIZE (35)
 #define NRF_CRYPTO_EXAMPLE_AES_GCM_TAG_LENGTH (16)
 
 /* AES sample IV, DO NOT USE IN PRODUCTION */
 static uint8_t m_iv[NRF_CRYPTO_EXAMPLE_AES_IV_SIZE];
 
 /* Below text is used as plaintext for encryption/decryption */
 static uint8_t m_plain_text[NRF_CRYPTO_EXAMPLE_AES_MAX_TEXT_SIZE] = {
	 "Example string to demonstrate basic usage of AES GCM mode."
 };
 
 /* Below text is used as additional data for authentication */
 static uint8_t m_additional_data[NRF_CRYPTO_EXAMPLE_AES_ADDITIONAL_SIZE] = {
	 "Example string of additional data"
 };
 
 static uint8_t m_encrypted_text[NRF_CRYPTO_EXAMPLE_AES_MAX_TEXT_SIZE +
				 NRF_CRYPTO_EXAMPLE_AES_GCM_TAG_LENGTH];
 
 static uint8_t m_decrypted_text[NRF_CRYPTO_EXAMPLE_AES_MAX_TEXT_SIZE];
 
 static psa_key_id_t key_id;
 /* ====================================================================== */
 
 int crypto_init(void)
 {
	 psa_status_t status;
 
	 /* Initialize PSA Crypto */
	 status = psa_crypto_init();
	 if (status != PSA_SUCCESS) {
		 return APP_ERROR;
	 }
 
	 return APP_SUCCESS;
 }
 
 int crypto_finish(void)
 {
	 psa_status_t status;
 
	 /* Destroy the key handle */
	 status = psa_destroy_key(key_id);
	 if (status != PSA_SUCCESS) {
		 LOG_INF("psa_destroy_key failed! (Error: %d)", status);
		 return APP_ERROR;
	 }
 
	 return APP_SUCCESS;
 }
 
 int generate_key(void)
 {
	 psa_status_t status;
 
	 LOG_INF("Generating random AES key...");
 
	 /* Configure the key attributes */
	 psa_key_attributes_t key_attributes = PSA_KEY_ATTRIBUTES_INIT;
 
	 psa_set_key_usage_flags(&key_attributes, PSA_KEY_USAGE_ENCRYPT | PSA_KEY_USAGE_DECRYPT);
	 psa_set_key_lifetime(&key_attributes, PSA_KEY_LIFETIME_VOLATILE);
	 psa_set_key_algorithm(&key_attributes, PSA_ALG_GCM);
	 psa_set_key_type(&key_attributes, PSA_KEY_TYPE_AES);
	 psa_set_key_bits(&key_attributes, 128);
 
	 /* Generate a random key. The key is not exposed to the application,
	  * we can use it to encrypt/decrypt using the key handle
	  */
	 status = psa_generate_key(&key_attributes, &key_id);
	 if (status != PSA_SUCCESS) {
		 LOG_INF("psa_generate_key failed! (Error: %d)", status);
		 return APP_ERROR;
	 }
 
	 /* After the key handle is acquired the attributes are not needed */
	 psa_reset_key_attributes(&key_attributes);
 
	 LOG_INF("AES key generated successfully!");
 
	 return 0;
 }
 
 int encrypt_aes_gcm(void)
 {
	 uint32_t output_len;
	 psa_status_t status;
 
	 LOG_INF("Encrypting using AES GCM MODE...");
 
	 /* Generate a random IV */
	 status = psa_generate_random(m_iv, NRF_CRYPTO_EXAMPLE_AES_IV_SIZE);
	 if (status != PSA_SUCCESS) {
		 LOG_INF("psa_generate_random failed! (Error: %d)", status);
		 return APP_ERROR;
	 }
 
	 /* Encrypt the plaintext and create the authentication tag */
	 status = psa_aead_encrypt(key_id,
				   PSA_ALG_GCM,
				   m_iv,
				   sizeof(m_iv),
				   m_additional_data,
				   sizeof(m_additional_data),
				   m_plain_text,
				   sizeof(m_plain_text),
				   m_encrypted_text,
				   sizeof(m_encrypted_text),
				   &output_len);
	 if (status != PSA_SUCCESS) {
		 LOG_INF("psa_aead_encrypt failed! (Error: %d)", status);
		 return APP_ERROR;
	 }
 
	 LOG_INF("Encryption successful!");
	 PRINT_HEX("IV", m_iv, sizeof(m_iv));
	 PRINT_HEX("Additional data", m_additional_data, sizeof(m_additional_data));
	 PRINT_HEX("Plaintext", m_plain_text, sizeof(m_plain_text));
	 PRINT_HEX("Encrypted text", m_encrypted_text, sizeof(m_encrypted_text));
 
	 return APP_SUCCESS;
 }
 
 int decrypt_aes_gcm(void)
 {
	 uint32_t output_len;
	 psa_status_t status;
 
	 LOG_INF("Decrypting using AES GCM MODE...");
 
	 /* Decrypt and authenticate the encrypted data */
	 status = psa_aead_decrypt(key_id,
				   PSA_ALG_GCM,
				   m_iv,
				   sizeof(m_iv),
				   m_additional_data,
				   sizeof(m_additional_data),
				   m_encrypted_text,
				   sizeof(m_encrypted_text),
				   m_decrypted_text,
				   sizeof(m_decrypted_text),
				   &output_len);
	 if (status != PSA_SUCCESS) {
		 LOG_INF("psa_aead_decrypt failed! (Error: %d)", status);
		 return APP_ERROR;
	 }
 
	 PRINT_HEX("Decrypted text", m_decrypted_text, sizeof(m_decrypted_text));
 
	 /* Check the validity of the decryption */
	 if (memcmp(m_decrypted_text, m_plain_text, NRF_CRYPTO_EXAMPLE_AES_MAX_TEXT_SIZE) != 0) {
		 LOG_INF("Error: Decrypted text doesn't match the plaintext");
		 return APP_ERROR;
	 }
 
	 LOG_INF("Decryption and authentication successful!");
 
	 return APP_SUCCESS;
 }
 
 int main(void)
 {
	 int status;
 
	 #ifdef	CAPTURE_TIMING
 
		 //variables needed for capturing the time elapsed.
		 timing_t start_time, end_time;
		 uint64_t total_cycles;
		 uint64_t total_ns;
 
		 // initiate the timer and start it counting...
		 timing_init();
		 timing_start(); 
 
	 #endif
 
	 LOG_INF("Starting AES-GCM example...");
 
	 status = crypto_init();
	 if (status != APP_SUCCESS) {
		 LOG_INF(APP_ERROR_MESSAGE);
		 return APP_ERROR;
	 }
 
	 status = generate_key();
	 if (status != APP_SUCCESS) {
		 LOG_INF(APP_ERROR_MESSAGE);
		 return APP_ERROR;
	 }
 
	 #ifdef	CAPTURE_TIMING
		 start_time = timing_counter_get();
	 #endif
 
	 status = encrypt_aes_gcm();
	 
	 #ifdef CAPTURE_TIMING
		 end_time = timing_counter_get();
		 
		 total_cycles = timing_cycles_get(&start_time, &end_time);
		 total_ns = timing_cycles_to_ns(total_cycles);
		 //total_ms = total_ns/1000000.0;
 
		 timing_stop();
 
		 printk("Total nanoseconds to run encrypt AES GCM is %llu\n",total_ns);
		 LOG_INF("Total nanoseconds to run encrypt AES GCM is %llu\n", total_ns); 
	 #endif
	 
	 if (status != APP_SUCCESS) {
		 LOG_INF(APP_ERROR_MESSAGE);
		 return APP_ERROR;
	 }
 
	 status = decrypt_aes_gcm();
	 if (status != APP_SUCCESS) {
		 LOG_INF(APP_ERROR_MESSAGE);
		 return APP_ERROR;
	 }
 
	 status = crypto_finish();
	 if (status != APP_SUCCESS) {
		 LOG_INF(APP_ERROR_MESSAGE);
		 return APP_ERROR;
	 }
 
	 LOG_INF(APP_SUCCESS_MESSAGE);
 
	 return APP_SUCCESS;
 }
 
```
